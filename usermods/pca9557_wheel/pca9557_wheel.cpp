#include "wled.h"

// AI: below section was generated by an AI
/*
 * 3-way thumb wheel (up / push / down) read through a PCA9557 I2C I/O expander,
 * e.g. on the Seengreat RGB Matrix HUB75 S3 board (K1/K2/K3 on PCA9557 IO1/IO3/IO2, active low).
 *
 * Only the input register is read. The expander's config/output registers are never written,
 * because on some boards other PCA9557 pins drive enable lines of onboard chips.
 *
 * Default actions (used when no preset is configured for that key):
 *   up:   short = brightness up,   hold = brightness up (repeating)
 *   down: short = brightness down, hold = brightness down (repeating)
 *   push: short = toggle on/off,   hold = next effect
 */

#define PCA9557_REG_INPUT 0x00
#define WHEEL_POLL_MS      20  // also acts as debounce interval (state must be stable for 2 polls)
#define WHEEL_LONG_MS     600  // hold time before long action fires
#define WHEEL_REPEAT_MS   150  // repeat interval of long action for up/down
#define WHEEL_BRI_STEP     16

class PCA9557Wheel : public Usermod {
  private:
    enum Key : uint8_t { KEY_UP, KEY_PUSH, KEY_DOWN, KEY_COUNT };

    bool enabled = true;
    bool initDone = false;
    uint8_t addr = 0x19;
    uint8_t bit[KEY_COUNT] = {1, 3, 2};    // PCA9557 IO number per key (Seengreat: K1=IO1, K2=IO3, K3=IO2)
    uint8_t preset[KEY_COUNT] = {0, 0, 0}; // short press preset, 0 = default action
    uint8_t presetLong[KEY_COUNT] = {0, 0, 0};

    unsigned long lastPoll = 0;
    uint8_t lastRaw = 0xFF;
    uint8_t stable = 0xFF;                 // debounced input register, active low
    unsigned long pressedAt[KEY_COUNT] = {0};
    unsigned long lastRepeat[KEY_COUNT] = {0};
    bool longFired[KEY_COUNT] = {false};

    static const char _name[];
    static const char _enabled[];
    static const char _addr[];
    static const char* const _keyNames[KEY_COUNT];

    // returns false if the expander did not answer
    bool readInput(uint8_t &value) {
      Wire.beginTransmission(addr);
      Wire.write(PCA9557_REG_INPUT);
      if (Wire.endTransmission(false) != 0) return false;
      if (Wire.requestFrom(addr, (uint8_t)1) != 1) return false;
      value = Wire.read();
      return true;
    }

    void changeBri(int delta) {
      if (bri == 0 && delta < 0) return; // already off
      bri = constrain((int)bri + delta, 1, 255);
      stateUpdated(CALL_MODE_BUTTON);
    }

    void shortAction(uint8_t k) {
      if (preset[k]) { applyPreset(preset[k], CALL_MODE_BUTTON_PRESET); return; }
      switch (k) {
        case KEY_UP:   changeBri(WHEEL_BRI_STEP); break;
        case KEY_DOWN: changeBri(-WHEEL_BRI_STEP); break;
        case KEY_PUSH: toggleOnOff(); stateUpdated(CALL_MODE_BUTTON); break;
      }
    }

    // called once when hold time is reached, then repeatedly for up/down
    void longAction(uint8_t k) {
      if (presetLong[k]) { if (!longFired[k]) applyPreset(presetLong[k], CALL_MODE_BUTTON_PRESET); return; }
      switch (k) {
        case KEY_UP:   changeBri(WHEEL_BRI_STEP); break;
        case KEY_DOWN: changeBri(-WHEEL_BRI_STEP); break;
        case KEY_PUSH:
          if (!longFired[k]) { ++effectCurrent %= strip.getModeCount(); stateChanged = true; colorUpdated(CALL_MODE_BUTTON); }
          break;
      }
    }

  public:
    void setup() override {
      if (i2c_scl < 0 || i2c_sda < 0) { enabled = false; return; }
      uint8_t v;
      if (!readInput(v)) DEBUG_PRINTF_P(PSTR("PCA9557: no response at 0x%02X\n"), addr);
      initDone = true;
    }

    void loop() override {
      if (!enabled || !initDone || millis() - lastPoll < WHEEL_POLL_MS) return;
      unsigned long now = millis();
      lastPoll = now;

      uint8_t raw;
      if (!readInput(raw)) return;
      if (raw != lastRaw) { lastRaw = raw; return; } // wait until stable for one more poll
      if (raw != stable) DEBUG_PRINTF_P(PSTR("PCA9557: input 0x%02X\n"), raw);

      for (uint8_t k = 0; k < KEY_COUNT; k++) {
        uint8_t mask = 1 << (bit[k] & 7);
        bool down = !(raw & mask);
        bool wasDown = !(stable & mask);

        if (down && !wasDown) {
          pressedAt[k] = now;
          longFired[k] = false;
        } else if (down) {
          if (!longFired[k] && now - pressedAt[k] >= WHEEL_LONG_MS) {
            longAction(k);
            longFired[k] = true;
            lastRepeat[k] = now;
          } else if (longFired[k] && k != KEY_PUSH && now - lastRepeat[k] >= WHEEL_REPEAT_MS) {
            longAction(k);
            lastRepeat[k] = now;
          }
        } else if (wasDown && !longFired[k]) {
          shortAction(k);
        }
      }
      stable = raw;
    }

    void addToConfig(JsonObject &root) override {
      JsonObject top = root.createNestedObject(FPSTR(_name));
      top[FPSTR(_enabled)] = enabled;
      top[FPSTR(_addr)] = addr;
      for (uint8_t k = 0; k < KEY_COUNT; k++) {
        JsonObject key = top.createNestedObject(FPSTR(_keyNames[k]));
        key[F("io")] = bit[k];
        key[F("preset")] = preset[k];
        key[F("presetLong")] = presetLong[k];
      }
    }

    bool readFromConfig(JsonObject &root) override {
      JsonObject top = root[FPSTR(_name)];
      bool configComplete = !top.isNull();
      configComplete &= getJsonValue(top[FPSTR(_enabled)], enabled, true);
      configComplete &= getJsonValue(top[FPSTR(_addr)], addr, (uint8_t)0x19);
      const uint8_t defBit[KEY_COUNT] = {1, 3, 2};
      for (uint8_t k = 0; k < KEY_COUNT; k++) {
        JsonObject key = top[FPSTR(_keyNames[k])];
        configComplete &= getJsonValue(key[F("io")], bit[k], defBit[k]);
        configComplete &= getJsonValue(key[F("preset")], preset[k], (uint8_t)0);
        configComplete &= getJsonValue(key[F("presetLong")], presetLong[k], (uint8_t)0);
      }
      return configComplete;
    }
};

const char PCA9557Wheel::_name[]    PROGMEM = "PCA9557Wheel";
const char PCA9557Wheel::_enabled[] PROGMEM = "enabled";
const char PCA9557Wheel::_addr[]    PROGMEM = "i2cAddress";
static const char _up[]   PROGMEM = "up";
static const char _push[] PROGMEM = "push";
static const char _down[] PROGMEM = "down";
const char* const PCA9557Wheel::_keyNames[KEY_COUNT] = {_up, _push, _down};

static PCA9557Wheel pca9557Wheel;
REGISTER_USERMOD(pca9557Wheel);
// AI: end
